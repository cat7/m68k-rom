## hw/m68k/Kconfig
```kconfig
config AN5206
    bool
    default y
    depends on M68K
    select COLDFIRE
    select PTIMER

config MCF5208
    bool
    default y
    depends on M68K
    select COLDFIRE
    select PTIMER

config NEXTCUBE
    bool
    default y
    depends on M68K
    select FRAMEBUFFER
    select ESCC
    select EMPTY_SLOT

config MAC_QUADRA
    bool
    select MAC_VIA
    select NUBUS
    select MACFB
    select SWIM2
    select ESCC
    select ESP
    select DP8393X
    select OR_IRQ
    select SPLIT_IRQ
    select ASC

config Q800
    bool
    default y
    depends on M68K
    select MAC_QUADRA
    select DJMEMC
    select IOSB

config Q700
    bool
    default y
    depends on M68K
    select MAC_QUADRA
    select ORWELL

config Q900
    bool
    default y
    depends on M68K
    select MAC_QUADRA
    select ORWELL
    select MAC_IOP

config Q950
    bool
    default y
    depends on M68K
    select MAC_QUADRA
    select ORWELL
    select MAC_IOP

config LC475
    bool
    default y
    depends on M68K
    select MAC_QUADRA
    select DJMEMC
    select IOSB

config MACLC
    bool
    default y
    depends on M68K
    select NCR5380
    select MAC_VIA
    select MAC_PSEUDOVIA
    select MAC_LC_VIDEO
    select NUBUS
    select ESCC
    select OR_IRQ
    select ASC
    select SWIM2

config Q840AV
    bool
    default y
    depends on M68K
    select MAC_VIA
    select MAC_PSC
    select MAC_CIVIC
    select MAC_MACE
    select NUBUS
    select ESCC
    select ESP

config M68K_VIRT
    bool
    default y
    depends on M68K
    select M68K_IRQC
    select VIRT_CTRL
    select GOLDFISH_PIC
    select GOLDFISH_TTY
    select GOLDFISH_RTC
    select VIRTIO_MMIO

config MACII
    bool
    default y
    depends on M68K
    select NCR5380
    select MAC_VIA
    select NUBUS
    select ESCC
    select OR_IRQ
    select ASC
    select SWIM2

config MACIIFX
    bool
    default y
    depends on M68K
    select NCR5380
    select MAC_VIA
    select MAC_OSS
    select MAC_IOP
    select NUBUS
    select ESCC
    select OR_IRQ
    select ASC
```
